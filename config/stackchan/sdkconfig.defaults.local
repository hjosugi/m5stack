## config/stackchan/sdkconfig.defaults.local
```kconfig
# 上流のsdkconfig.defaultsへ重ねる、日本語UI用の公開可能な差分。
CONFIG_LANGUAGE_EN_US=n
CONFIG_LANGUAGE_JA_JP=y
```

## stackchan/screen-link/components/screen_link_auth/Kconfig
```kconfig
menu "M5 Screen Link"

config SCREEN_LINK_AUTH_TOKEN
    string "Screen-link WebSocket authentication token"
    default "change-me"
    help
        Shared token sent in the Authorization header to the local PC relay.
        Override this value through an untracked sdkconfig defaults file.

endmenu
```
